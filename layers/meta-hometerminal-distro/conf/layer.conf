## layers/meta-hometerminal-distro/conf/layer.conf
```bitbake
# We have a conf and classes directory, add to BBPATH
BBPATH .= ":${LAYERDIR}"

# We have recipes-* directories, add to BBFILES
BBFILES += "${LAYERDIR}/recipes-*/*/*.bb \
            ${LAYERDIR}/recipes-*/*/*.bbappend"

BBFILE_COLLECTIONS += "hometerminal-distro-layer"
BBFILE_PATTERN_hometerminal-distro-layer = "^${LAYERDIR}/"
BBFILE_PRIORITY_hometerminal-distro-layer = "19"

LAYERDEPENDS_hometerminal-distro-layer = "core rauc raspberrypi"
LAYERSERIES_COMPAT_hometerminal-distro-layer = "kirkstone"
```

## layers/meta-hometerminal/conf/distro/hometerminal.conf
```bitbake
DISTRO_VERSION = "hometerminal 0.0.1"
SDK_VERSION ?= "${DISTRO_VERSION}"

# Prevent stacking up hundreds of old builds by not including a DATETIME in the image name
IMAGE_NAME = "${IMAGE_BASENAME}-${MACHINE}"
# and do not symlink; the link name will conflicht with IMAGE_NAME
IMAGE_LINK_NAME = ""
```

## layers/meta-hometerminal/conf/layer.conf
```bitbake
# We have a conf and classes directory, add to BBPATH
BBPATH .= ":${LAYERDIR}"

# We have recipes-* directories, add to BBFILES
BBFILES += "${LAYERDIR}/recipes-*/*/*.bb \
            ${LAYERDIR}/recipes-*/*/*.bbappend"

BBFILE_COLLECTIONS += "hometerminal-layer"
BBFILE_PATTERN_hometerminal-layer = "^${LAYERDIR}/"
BBFILE_PRIORITY_hometerminal-layer = "20"

LAYERDEPENDS_hometerminal-layer = "hometerminal-distro-layer"
LAYERSERIES_COMPAT_hometerminal-layer = "kirkstone"
```

## layers/meta-hometerminal/conf/machine/cm4-reterminal.conf
```bitbake
#@TYPE: Machine
#@NAME: Raspberry Pi CM4 module for Reterminal
#@DESCRIPTION: Configuration for the Reterminal CM4

# Start with the default raspberry pi 64 bit image
require conf/machine/raspberrypi4-64.conf

# Reterminal is equipped with PCI interface
MACHINE_FEATURES += "pci"
MACHINE_EXTRA_RRECOMMENDS += "\
    seeed-linux-dtoverlays \
"

PREFERRED_VERSION_linux-raspberrypi ?= "5.10.%"
RPI_KERNEL_DEVICETREE_OVERLAYS += " \
    overlays/reTerminal.dtbo \
    overlays/vc4-kms-v3d-pi4.dtbo \
    overlays/i2c3.dtbo \
"

# PACKAGECONFIG:append:pn-qtbase = " eglfs "
KERNEL_MODULE_AUTOLOAD:rpi += "i2c-dev"
ENABLE_I2C = "1"
ENABLE_UART = "1"
```
